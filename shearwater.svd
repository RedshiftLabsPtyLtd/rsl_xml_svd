# shearwater register map
Vendor: RedShift Labs; Series: IMU; File version: 0.3
Shearwater Board Peripheral Description
Address unit: 32 bits
Registers are 32-bit, read-write, reset 0x0 unless marked. A register's access mark holds for its fields unless they carry their own. Offsets are from the block's base; lines under a group give offsets from that group; [hi:lo] are bit positions; {n}, {i} and the like mark numbered series; 'fields as' and 'values as' point back to an identical list; <NAME> marks a mode.

## Memory map
0x00000000 MAIN_REGISTER_MAP size 0x500 — Fusion Configuration Registers for the shearwater board
0x00000000 HIDDEN_REGISTER_MAP size 0x500 — Hidden Registers for the shearwater board

## HIDDEN_REGISTER_MAP — Hidden Registers for the shearwater board
Base 0x00000000
? HIDDEN_GYRO_1_VARIANCE — TODO: add description
  [31:0] HIDDEN_GYRO_1_VARIANCE — 32-bit IEEE 754 Floating Point Value
? HIDDEN_GYRO_2_VARIANCE — TODO: add description
  [31:0] HIDDEN_GYRO_2_VARIANCE — 32-bit IEEE 754 Floating Point Value
? HIDDEN_ACCEL_1_VARIANCE — TODO: add description
  [31:0] HIDDEN_ACCEL_1_VARIANCE — 32-bit IEEE 754 Floating Point Value
? HIDDEN_MAG_1_VARIANCE — TODO: add description
  [31:0] HIDDEN_MAG_1_VARIANCE — 32-bit IEEE 754 Floating Point Value
? HIDDEN_MAG_2_VARIANCE — TODO: add description
  [31:0] HIDDEN_MAG_2_VARIANCE — 32-bit IEEE 754 Floating Point Value
? HIDDEN_GPS_COURSE_VARIANCE — TODO: add description
  [31:0] HIDDEN_GPS_COURSE_VARIANCE — 32-bit IEEE 754 Floating Point Value
? HIDDEN_GPS_POSITION_VARIANCE — TODO: add description
  [31:0] HIDDEN_GPS_POSITION_VARIANCE — 32-bit IEEE 754 Floating Point Value
? HIDDEN_GPS_VELOCITY_VARIANCE — TODO: add description
  [31:0] HIDDEN_GPS_VELOCITY_VARIANCE — 32-bit IEEE 754 Floating Point Value
? HIDDEN_STATIC_PRESS_VARIANCE — TODO: add description
  [31:0] HIDDEN_STATIC_PRESS_VARIANCE — 32-bit IEEE 754 Floating Point Value
? HIDDEN_DIFF_PRESS_VARIANCE — TODO: add description
  [31:0] HIDDEN_DIFF_PRESS_VARIANCE — 32-bit IEEE 754 Floating Point Value
? HIDDEN_Q_UVW — TODO: add description
  [31:0] HIDDEN_Q_UVW — 32-bit IEEE 754 Floating Point Value
? HIDDEN_Q_QUATERNION — TODO: add description
  [31:0] HIDDEN_Q_QUATERNION — 32-bit IEEE 754 Floating Point Value
? HIDDEN_Q_GPS_POSITION — TODO: add description
  [31:0] HIDDEN_Q_GPS_POSITION — 32-bit IEEE 754 Floating Point Value
? HIDDEN_Q_BIAS — TODO: add description
  [31:0] HIDDEN_Q_BIAS — 32-bit IEEE 754 Floating Point Value
? HIDDEN_Q_EULER_ANGLES — TODO: add description
  [31:0] HIDDEN_Q_EULER_ANGLES — 32-bit IEEE 754 Floating Point Value
? HIDDEN_LOW_VG_ACCEL_NOISE_FACTOR — TODO: add description
  [31:0] HIDDEN_LOW_VG_ACCEL_NOISE_FACTOR — 32-bit IEEE 754 Floating Point Value
? HIDDEN_LPF_TAU_GROUNDSPEED — TODO: add description
  [31:0] HIDDEN_LPF_TAU_GROUNDSPEED — 32-bit IEEE 754 Floating Point Value
? HIDDEN_LPF_TAU_GYRO_1 — TODO: add description
  [31:0] HIDDEN_LPF_TAU_GYRO_1 — 32-bit IEEE 754 Floating Point Value
? HIDDEN_LPF_TAU_GYRO_2 — TODO: add description
  [31:0] HIDDEN_LPF_TAU_GYRO_2 — 32-bit IEEE 754 Floating Point Value
? HIDDEN_LPF_TAU_ACCEL_1 — TODO: add description
  [31:0] HIDDEN_LPF_TAU_ACCEL_1 — 32-bit IEEE 754 Floating Point Value
? HIDDEN_LPF_TAU_MAG_1 — TODO: add description
  [31:0] HIDDEN_LPF_TAU_MAG_1 — 32-bit IEEE 754 Floating Point Value
? HIDDEN_LPF_TAU_MAG_2 — TODO: add description
  [31:0] HIDDEN_LPF_TAU_MAG_2 — 32-bit IEEE 754 Floating Point Value
? HIDDEN_C_GYRO_1_BIAS_X_POW_{i} (i=0..3) — TODO: add description
  [31:0] HIDDEN_C_GYRO_1_BIAS_X_POW_{i} — 32-bit IEEE 754 Floating Point Value
? HIDDEN_C_GYRO_1_BIAS_Y_POW_{i} (i=0..3) — TODO: add description
  [31:0] HIDDEN_C_GYRO_1_BIAS_Y_POW_{i} — 32-bit IEEE 754 Floating Point Value
? HIDDEN_C_GYRO_1_BIAS_Z_POW_{i} (i=0..3) — TODO: add description
  [31:0] HIDDEN_C_GYRO_1_BIAS_Z_POW_{i} — 32-bit IEEE 754 Floating Point Value
? HIDDEN_C_GYRO_1_SCALE_X_POW_{i} (i=0..3) — TODO: add description
  [31:0] HIDDEN_C_GYRO_1_SCALE_X_POW_{i} — 32-bit IEEE 754 Floating Point Value
? HIDDEN_C_GYRO_1_SCALE_Y_POW_{i} (i=0..3) — TODO: add description
  [31:0] HIDDEN_C_GYRO_1_SCALE_Y_POW_{i} — 32-bit IEEE 754 Floating Point Value
? HIDDEN_C_GYRO_1_SCALE_Z_POW_{i} (i=0..3) — TODO: add description
  [31:0] HIDDEN_C_GYRO_1_SCALE_Z_POW_{i} — 32-bit IEEE 754 Floating Point Value
? HIDDEN_GYRO_1_ALIGNMENT{i}_1 (i=1..3) — TODO: add description
  [31:0] HIDDEN_GYRO_1_ALIGNMENT{i}_1 — 32-bit IEEE 754 Floating Point Value
? HIDDEN_GYRO_1_ALIGNMENT{i}_2 (i=1..3) — TODO: add description
  [31:0] HIDDEN_GYRO_1_ALIGNMENT{i}_2 — 32-bit IEEE 754 Floating Point Value
? HIDDEN_GYRO_1_ALIGNMENT{i}_3 (i=1..3) — TODO: add description
  [31:0] HIDDEN_GYRO_1_ALIGNMENT{i}_3 — 32-bit IEEE 754 Floating Point Value
? HIDDEN_C_GYRO_2_BIAS_X_POW_{i} (i=0..3) — TODO: add description
  [31:0] HIDDEN_C_GYRO_2_BIAS_X_POW_{i} — 32-bit IEEE 754 Floating Point Value
? HIDDEN_C_GYRO_2_BIAS_Y_POW_{i} (i=0..3) — TODO: add description
  [31:0] HIDDEN_C_GYRO_2_BIAS_Y_POW_{i} — 32-bit IEEE 754 Floating Point Value
? HIDDEN_C_GYRO_2_BIAS_Z_POW_{i} (i=0..3) — TODO: add description
  [31:0] HIDDEN_C_GYRO_2_BIAS_Z_POW_{i} — 32-bit IEEE 754 Floating Point Value
? HIDDEN_C_GYRO_2_SCALE_X_POW_{i} (i=0..3) — TODO: add description
  [31:0] HIDDEN_C_GYRO_2_SCALE_X_POW_{i} — 32-bit IEEE 754 Floating Point Value
? HIDDEN_C_GYRO_2_SCALE_Y_POW_{i} (i=0..3) — TODO: add description
  [31:0] HIDDEN_C_GYRO_2_SCALE_Y_POW_{i} — 32-bit IEEE 754 Floating Point Value
? HIDDEN_C_GYRO_2_SCALE_Z_POW_{i} (i=0..3) — TODO: add description
  [31:0] HIDDEN_C_GYRO_2_SCALE_Z_POW_{i} — 32-bit IEEE 754 Floating Point Value
? HIDDEN_GYRO_2_ALIGNMENT{i}_1 (i=1..3) — TODO: add description
  [31:0] HIDDEN_GYRO_2_ALIGNMENT{i}_1 — 32-bit IEEE 754 Floating Point Value
? HIDDEN_GYRO_2_ALIGNMENT{i}_2 (i=1..3) — TODO: add description
  [31:0] HIDDEN_GYRO_2_ALIGNMENT{i}_2 — 32-bit IEEE 754 Floating Point Value
? HIDDEN_GYRO_2_ALIGNMENT{i}_3 (i=1..3) — TODO: add description
  [31:0] HIDDEN_GYRO_2_ALIGNMENT{i}_3 — 32-bit IEEE 754 Floating Point Value
? HIDDEN_C_ACCEL_1_BIAS_X_POW_{i} (i=0..3) — TODO: add description
  [31:0] HIDDEN_C_ACCEL_1_BIAS_X_POW_{i} — 32-bit IEEE 754 Floating Point Value
? HIDDEN_C_ACCEL_1_BIAS_Y_POW_{i} (i=0..3) — TODO: add description
  [31:0] HIDDEN_C_ACCEL_1_BIAS_Y_POW_{i} — 32-bit IEEE 754 Floating Point Value
? HIDDEN_C_ACCEL_1_BIAS_Z_POW_{i} (i=0..3) — TODO: add description
  [31:0] HIDDEN_C_ACCEL_1_BIAS_Z_POW_{i} — 32-bit IEEE 754 Floating Point Value
? HIDDEN_C_ACCEL_1_SCALE_X_POW_{i} (i=0..3) — TODO: add description
  [31:0] HIDDEN_C_ACCEL_1_SCALE_X_POW_{i} — 32-bit IEEE 754 Floating Point Value
? HIDDEN_C_ACCEL_1_SCALE_Y_POW_{i} (i=0..3) — TODO: add description
  [31:0] HIDDEN_C_ACCEL_1_SCALE_Y_POW_{i} — 32-bit IEEE 754 Floating Point Value
? HIDDEN_C_ACCEL_1_SCALE_Z_POW_{i} (i=0..3) — TODO: add description
  [31:0] HIDDEN_C_ACCEL_1_SCALE_Z_POW_{i} — 32-bit IEEE 754 Floating Point Value
? HIDDEN_ACCEL_1_ALIGNMENT{i}_1 (i=1..3) — TODO: add description
  [31:0] HIDDEN_ACCEL_1_ALIGNMENT{i}_1 — 32-bit IEEE 754 Floating Point Value
? HIDDEN_ACCEL_1_ALIGNMENT{i}_2 (i=1..3) — TODO: add description
  [31:0] HIDDEN_ACCEL_1_ALIGNMENT{i}_2 — 32-bit IEEE 754 Floating Point Value
? HIDDEN_ACCEL_1_ALIGNMENT{i}_3 (i=1..3) — TODO: add description
  [31:0] HIDDEN_ACCEL_1_ALIGNMENT{i}_3 — 32-bit IEEE 754 Floating Point Value
? HIDDEN_C_MAG_1_BIAS_X_POW_{i} (i=0..3) — TODO: add description
  [31:0] HIDDEN_C_MAG_1_BIAS_X_POW_{i} — 32-bit IEEE 754 Floating Point Value
? HIDDEN_C_MAG_1_BIAS_Y_POW_{i} (i=0..3) — TODO: add description
  [31:0] HIDDEN_C_MAG_1_BIAS_Y_POW_{i} — 32-bit IEEE 754 Floating Point Value
? HIDDEN_C_MAG_1_BIAS_Z_POW_{i} (i=0..3) — TODO: add description
  [31:0] HIDDEN_C_MAG_1_BIAS_Z_POW_{i} — 32-bit IEEE 754 Floating Point Value
? HIDDEN_C_MAG_1_SCALE_X_POW_{i} (i=0..3) — TODO: add description
  [31:0] HIDDEN_C_MAG_1_SCALE_X_POW_{i} — 32-bit IEEE 754 Floating Point Value
? HIDDEN_C_MAG_1_SCALE_Y_POW_{i} (i=0..3) — TODO: add description
  [31:0] HIDDEN_C_MAG_1_SCALE_Y_POW_{i} — 32-bit IEEE 754 Floating Point Value
? HIDDEN_C_MAG_1_SCALE_Z_POW_{i} (i=0..3) — TODO: add description
  [31:0] HIDDEN_C_MAG_1_SCALE_Z_POW_{i} — 32-bit IEEE 754 Floating Point Value
? HIDDEN_MAG_1_ALIGNMENT{i}_1 (i=1..3) — TODO: add description
  [31:0] HIDDEN_MAG_1_ALIGNMENT{i}_1 — 32-bit IEEE 754 Floating Point Value
? HIDDEN_MAG_1_ALIGNMENT{i}_2 (i=1..3) — TODO: add description
  [31:0] HIDDEN_MAG_1_ALIGNMENT{i}_2 — 32-bit IEEE 754 Floating Point Value
? HIDDEN_MAG_1_ALIGNMENT{i}_3 (i=1..3) — TODO: add description
  [31:0] HIDDEN_MAG_1_ALIGNMENT{i}_3 — 32-bit IEEE 754 Floating Point Value
? HIDDEN_MAG_1_REFERENCE_X — TODO: add description
  [31:0] HIDDEN_MAG_1_REFERENCE_X — 32-bit IEEE 754 Floating Point Value
? HIDDEN_MAG_1_REFERENCE_Y — TODO: add description
  [31:0] HIDDEN_MAG_1_REFERENCE_Y — 32-bit IEEE 754 Floating Point Value
? HIDDEN_MAG_1_REFERENCE_Z — TODO: add description
  [31:0] HIDDEN_MAG_1_REFERENCE_Z — 32-bit IEEE 754 Floating Point Value
? HIDDEN_C_MAG_2_BIAS_X_POW_{i} (i=0..3) — TODO: add description
  [31:0] HIDDEN_C_MAG_2_BIAS_X_POW_{i} — 32-bit IEEE 754 Floating Point Value
? HIDDEN_C_MAG_2_BIAS_Y_POW_{i} (i=0..3) — TODO: add description
  [31:0] HIDDEN_C_MAG_2_BIAS_Y_POW_{i} — 32-bit IEEE 754 Floating Point Value
? HIDDEN_C_MAG_2_BIAS_Z_POW_{i} (i=0..3) — TODO: add description
  [31:0] HIDDEN_C_MAG_2_BIAS_Z_POW_{i} — 32-bit IEEE 754 Floating Point Value
? HIDDEN_C_MAG_2_SCALE_X_POW_{i} (i=0..3) — TODO: add description
  [31:0] HIDDEN_C_MAG_2_SCALE_X_POW_{i} — 32-bit IEEE 754 Floating Point Value
? HIDDEN_C_MAG_2_SCALE_Y_POW_{i} (i=0..3) — TODO: add description
  [31:0] HIDDEN_C_MAG_2_SCALE_Y_POW_{i} — 32-bit IEEE 754 Floating Point Value
? HIDDEN_C_MAG_2_SCALE_Z_POW_{i} (i=0..3) — TODO: add description
  [31:0] HIDDEN_C_MAG_2_SCALE_Z_POW_{i} — 32-bit IEEE 754 Floating Point Value
? HIDDEN_MAG_2_ALIGNMENT{i}_1 (i=1..3) — TODO: add description
  [31:0] HIDDEN_MAG_2_ALIGNMENT{i}_1 — 32-bit IEEE 754 Floating Point Value
? HIDDEN_MAG_2_ALIGNMENT{i}_2 (i=1..3) — TODO: add description
  [31:0] HIDDEN_MAG_2_ALIGNMENT{i}_2 — 32-bit IEEE 754 Floating Point Value
? HIDDEN_MAG_2_ALIGNMENT{i}_3 (i=1..3) — TODO: add description
  [31:0] HIDDEN_MAG_2_ALIGNMENT{i}_3 — 32-bit IEEE 754 Floating Point Value
? HIDDEN_MAG_2_REFERENCE_X — TODO: add description
  [31:0] HIDDEN_MAG_2_REFERENCE_X — 32-bit IEEE 754 Floating Point Value
? HIDDEN_MAG_2_REFERENCE_Y — TODO: add description
  [31:0] HIDDEN_MAG_2_REFERENCE_Y — 32-bit IEEE 754 Floating Point Value
? HIDDEN_MAG_2_REFERENCE_Z — TODO: add description
  [31:0] HIDDEN_MAG_2_REFERENCE_Z — 32-bit IEEE 754 Floating Point Value
? HIDDEN_GYRO_1_CONVERSION ro — TODO: add description
  [31:0] HIDDEN_GYRO_1_CONVERSION — 32-bit IEEE 754 Floating Point Value
? HIDDEN_GYRO_2_CONVERSION ro — TODO: add description
  [31:0] HIDDEN_GYRO_2_CONVERSION — 32-bit IEEE 754 Floating Point Value
? HIDDEN_ACCEL_1_CONVERSION ro — TODO: add description
  [31:0] HIDDEN_ACCEL_1_CONVERSION — 32-bit IEEE 754 Floating Point Value
? HIDDEN_MAG_1_CONVERSION ro — TODO: add description
  [31:0] HIDDEN_MAG_1_CONVERSION — 32-bit IEEE 754 Floating Point Value
? HIDDEN_MAG_2_CONVERSION ro — TODO: add description
  [31:0] HIDDEN_MAG_2_CONVERSION — 32-bit IEEE 754 Floating Point Value

## Licence text in the file
Redshift Labs Pty Ltd modified this file. ARM Limited (ARM) is supplying this software for use with Cortex-M processor based microcontroller, but can be equally used for other suitable processor architectures. This file can be freely distributed. Modifications to this file shall be clearly marked. . THIS SOFTWARE IS PROVIDED "AS IS". NO WARRANTIES, WHETHER EXPRESS, IMPLIED. OR STATUTORY, INCLUDING, BUT NOT LIMITED TO, IMPLIED WARRANTIES OF. MERCHANTABILITY AND FITNESS FOR A PARTICULAR PURPOSE APPLY TO THIS SOFTWARE. ARM SHALL NOT, IN ANY CIRCUMSTANCES, BE LIABLE FOR SPECIAL, INCIDENTAL, OR. CONSEQUENTIAL DAMAGES, FOR ANY REASON WHATSOEVER.

## Notices in the file
Copyright (C) 2012-2014 ARM Limited. All rights reserved.
Redistribution and use in source and binary forms, with or without
modification, are permitted provided that the following conditions are met:
- Redistributions of source code must retain the above copyright
notice, this list of conditions and the following disclaimer.
- Redistributions in binary form must reproduce the above copyright
notice, this list of conditions and the following disclaimer in the
documentation and/or other materials provided with the distribution.
- Neither the name of ARM nor the names of its contributors may be used
to endorse or promote products derived from this software without
specific prior written permission.
THIS SOFTWARE IS PROVIDED BY THE COPYRIGHT HOLDERS AND CONTRIBUTORS "AS IS"
AND ANY EXPRESS OR IMPLIED WARRANTIES, INCLUDING, BUT NOT LIMITED TO, THE
ARE DISCLAIMED. IN NO EVENT SHALL COPYRIGHT HOLDERS AND CONTRIBUTORS BE
LIABLE FOR ANY DIRECT, INDIRECT, INCIDENTAL, SPECIAL, EXEMPLARY, OR
CONSEQUENTIAL DAMAGES (INCLUDING, BUT NOT LIMITED TO, PROCUREMENT OF
SUBSTITUTE GOODS OR SERVICES; LOSS OF USE, DATA, OR PROFITS; OR BUSINESS
INTERRUPTION) HOWEVER CAUSED AND ON ANY THEORY OF LIABILITY, WHETHER IN
CONTRACT, STRICT LIABILITY, OR TORT (INCLUDING NEGLIGENCE OR OTHERWISE)
ARISING IN ANY WAY OUT OF THE USE OF THIS SOFTWARE, EVEN IF ADVISED OF THE
POSSIBILITY OF SUCH DAMAGE.
